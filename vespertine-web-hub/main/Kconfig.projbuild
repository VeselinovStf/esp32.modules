## vespertine-web-hub/main/Kconfig.projbuild
```kconfig
menu "WIFI Configuration"

    config WIFI_SSID
        string "WiFi SSID"
        default "myssid"
        help
            SSID (network name) for the example to connect to.

    config WIFI_PASSWORD
        string "WiFi Password"
        default "mypassword"
        help
            WiFi password (WPA or WPA2) for the example to use.

    choice ESP_WIFI_SAE_MODE
        prompt "WPA3 SAE mode selection"
        default ESP_WPA3_SAE_PWE_BOTH
        help
            Select mode for SAE as Hunt and Peck, H2E or both.
        config ESP_WPA3_SAE_PWE_HUNT_AND_PECK
            bool "HUNT AND PECK"
        config ESP_WPA3_SAE_PWE_HASH_TO_ELEMENT
            bool "H2E"
        config ESP_WPA3_SAE_PWE_BOTH
            bool "BOTH"
    endchoice

    config ESP_WIFI_PW_ID
        string "PASSWORD IDENTIFIER"
        depends on  ESP_WPA3_SAE_PWE_HASH_TO_ELEMENT|| ESP_WPA3_SAE_PWE_BOTH
        default ""
        help
            password identifier for SAE H2E

    config ESP_MAXIMUM_RETRY
        int "Maximum retry"
        default 5
        help
            Set the Maximum retry to avoid station reconnecting to the AP unlimited when the AP is really inexistent.

    choice ESP_WIFI_SCAN_AUTH_MODE_THRESHOLD
        prompt "WiFi Scan auth mode threshold"
        default ESP_WIFI_AUTH_WPA2_PSK
        help
            The weakest authmode to accept in the scan mode.
            This value defaults to ESP_WIFI_AUTH_WPA2_PSK incase password is present and ESP_WIFI_AUTH_OPEN is used.
            Please select ESP_WIFI_AUTH_WEP/ESP_WIFI_AUTH_WPA_PSK incase AP is operating in WEP/WPA mode.

        config ESP_WIFI_AUTH_OPEN
            bool "OPEN"
        config ESP_WIFI_AUTH_WEP
            bool "WEP"
        config ESP_WIFI_AUTH_WPA_PSK
            bool "WPA PSK"
        config ESP_WIFI_AUTH_WPA2_PSK
            bool "WPA2 PSK"
        config ESP_WIFI_AUTH_WPA_WPA2_PSK
            bool "WPA/WPA2 PSK"
        config ESP_WIFI_AUTH_WPA3_PSK
            bool "WPA3 PSK"
        config ESP_WIFI_AUTH_WPA2_WPA3_PSK
            bool "WPA2/WPA3 PSK"
        config ESP_WIFI_AUTH_WAPI_PSK
            bool "WAPI PSK"
    endchoice

endmenu


menu "SERVER Configuration"

    config EXAMPLE_MDNS_HOST_NAME
        string "mDNS Host Name"
        default "esp-home"
        help
            Specify the domain name used in the mDNS service.
            Note that webpage also take it as a part of URL where it will send GET/POST requests to.

    choice EXAMPLE_WEB_DEPLOY_MODE
        prompt "Website deploy mode"
        default EXAMPLE_WEB_DEPLOY_SF
        help
            Select website deploy mode.
            You can deploy website to host, and ESP32 will retrieve them in a semihost way (JTAG is needed).
            You can deploy website to SD card or SPI flash, and ESP32 will retrieve them via SDIO/SPI interface.
            Detailed operation steps are listed in the example README file.
        config EXAMPLE_WEB_DEPLOY_SEMIHOST
            bool "Deploy website to host (JTAG is needed)"
            help
                Deploy website to host.
                It is recommended to choose this mode during developing.
        config EXAMPLE_WEB_DEPLOY_SD
            depends on IDF_TARGET_ESP32
            bool "Deploy website to SD card"
            help
                Deploy website to SD card.
                Choose this production mode if the size of website is too large (bigger than 2MB).
        config EXAMPLE_WEB_DEPLOY_SF
            bool "Deploy website to SPI Nor Flash"
            help
                Deploy website to SPI Nor Flash.
                Choose this production mode if the size of website is small (less than 2MB).
    endchoice

    if EXAMPLE_WEB_DEPLOY_SEMIHOST
        config EXAMPLE_HOST_PATH_TO_MOUNT
            string "Host path to mount (e.g. absolute path to web dist directory)"
            default "C:\Users\Doni2\HUB\esp32.modules\lab-server-idf\front\web-demo\dist"
            help
                When using semihost in ESP32, you should specify the host path which will be mounted to VFS.
                Note that only absolute path is acceptable.
    endif

    config EXAMPLE_WEB_MOUNT_POINT
        string "Website mount point in VFS"
        default "/www"
        help
            Specify the mount point in VFS.

endmenu

menu "mDNS"

    config MDNS_MAX_INTERFACES
        int "Max number of interfaces"
        range 1 9
        default 3
        help
            Number of network interfaces to be served by the mDNS library.
            Lowering this number helps to reduce some static RAM usage.

    config MDNS_MAX_SERVICES
        int "Max number of services"
        default 10
        help
            Services take up a certain amount of memory, and allowing fewer
            services to be open at the same time conserves memory. Specify
            the maximum amount of services here.

    config MDNS_TASK_PRIORITY
        int "mDNS task priority"
        range 1 255
        default 1
        help
            Allows setting mDNS task priority. Please do not set the task priority
            higher than priorities of system tasks. Compile time warning/error
            would be emitted if the chosen task priority were too high.

    config MDNS_ACTION_QUEUE_LEN
        int "Maximum actions pending to the server"
        range 8 64
        default 16
        help
            Allows setting the length of mDNS action queue.

    config MDNS_TASK_STACK_SIZE
        int "mDNS task stack size"
        default 4096
        help
            Allows setting mDNS task stacksize.

    choice MDNS_TASK_AFFINITY
        prompt "mDNS task affinity"
        default MDNS_TASK_AFFINITY_CPU0
        help
            Allows setting mDNS tasks affinity, i.e. whether the task is pinned to
            CPU0, pinned to CPU1, or allowed to run on any CPU.

        config MDNS_TASK_AFFINITY_NO_AFFINITY
            bool "No affinity"
        config MDNS_TASK_AFFINITY_CPU0
            bool "CPU0"
        config MDNS_TASK_AFFINITY_CPU1
            bool "CPU1"
            depends on !FREERTOS_UNICORE

    endchoice

    config MDNS_TASK_AFFINITY
        hex
        default FREERTOS_NO_AFFINITY if MDNS_TASK_AFFINITY_NO_AFFINITY
        default 0x0 if MDNS_TASK_AFFINITY_CPU0
        default 0x1 if MDNS_TASK_AFFINITY_CPU1

    config MDNS_SERVICE_ADD_TIMEOUT_MS
        int "mDNS adding service timeout (ms)"
        range 10 30000
        default 2000
        help
            Configures timeout for adding a new mDNS service. Adding a service
            fails if could not be completed within this time.

    config MDNS_TIMER_PERIOD_MS
        int "mDNS timer period (ms)"
        range 10 10000
        default 100
        help
            Configures period of mDNS timer, which periodically transmits packets
            and schedules mDNS searches.

    config MDNS_NETWORKING_SOCKET
        bool "Use BSD sockets for mDNS networking"
        default n
        help
            Enables optional mDNS networking implementation using BSD sockets
            in UDP multicast mode.
            This option creates a new thread to serve receiving packets (TODO).
            This option uses additional N sockets, where N is number of interfaces.

    config MDNS_SKIP_SUPPRESSING_OWN_QUERIES
        bool "Skip suppressing our own packets"
        default n
        help
            Enable only if the querier and the responder share the same IP address.
            This usually happens in test mode, where we may run multiple instances of
            responders/queriers on the same interface.

    config MDNS_ENABLE_DEBUG_PRINTS
        bool "Enable debug prints of mDNS packets"
        default n
        help
            Enable for the library to log received and sent mDNS packets to stdout.

    config MDNS_RESPOND_REVERSE_QUERIES
        bool "Enable responding to IPv4 reverse queries"
        default n
        help
            Enables support for IPv4 reverse lookup. If enabled, the mDNS library
            response to PTR queries of "A.B.C.D.in-addr.arpa" type.

    config MDNS_MULTIPLE_INSTANCE
        bool "Multiple instances under the same service type"
        default y
        help
            Enables adding multiple service instances under the same service type.

    menu "MDNS Predefined interfaces"

        config MDNS_PREDEF_NETIF_STA
            bool "Use predefined interface for WiFi Station"
            default y
            help
                Set up mDNS for the default WiFi station.
                Disable this option if you do not need mDNS on default WiFi STA.

        config MDNS_PREDEF_NETIF_AP
            bool "Use predefined interface for WiFi Access Point"
            default y
            help
                Set up mDNS for the default WiFi Access Point.
                Disable this option if you do not need mDNS on default WiFi AP.

        config MDNS_PREDEF_NETIF_ETH
            bool "Use predefined interface for Ethernet"
            depends on ETH_ENABLED
            default y
            help
                Set up mDNS for the default Ethernet interface.
                Disable this option if you do not need mDNS on default Ethernet.

    endmenu # MDNS Predefined interfaces

endmenu
```

## vespertine-web-hub/sdkconfig.defaults
```kconfig
CONFIG_HTTPD_MAX_REQ_HDR_LEN=1024
CONFIG_SPIFFS_OBJ_NAME_LEN=64
CONFIG_FATFS_LFN_HEAP=y
CONFIG_ESPTOOLPY_FLASHSIZE_4MB=y
CONFIG_PARTITION_TABLE_CUSTOM=y
CONFIG_PARTITION_TABLE_CUSTOM_FILENAME="partitions_example.csv"
CONFIG_PARTITION_TABLE_FILENAME="partitions_example.csv"
CONFIG_MDNS_MAX_SERVICES=25
CONFIG_MDNS_MAX_INTERFACES=3
CONFIG_MDNS_TASK_PRIORITY=1
CONFIG_MDNS_ACTION_QUEUE_LEN=16
CONFIG_MDNS_TASK_STACK_SIZE=4096
CONFIG_MDNS_TASK_AFFINITY_CPU0=1
CONFIG_MDNS_TASK_AFFINITY=0x0
CONFIG_MDNS_SERVICE_ADD_TIMEOUT_MS=1
CONFIG_MDNS_TIMER_PERIOD_MS=100
CONFIG_WIFI_SSID="A1_41C2"
CONFIG_WIFI_PASSWORD="48575443E694A49D"
CONFIG_ESP_MAXIMUM_RETRY=5
CONFIG_WEB_DEPLOY_SEMIHOST=n
CONFIG_WEB_DEPLOY_SD=n
CONFIG_WEB_DEPLOY_SF=y
```
